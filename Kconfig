## drivers/Kconfig
```kconfig
menu "Device drivers"

config KMOD_HELLO
	tristate "Rust hello module (test)"
	default n
	help
	  Test module used by the kmod pipeline. =y is accepted and ignored (no
	  built-in form exists); =m builds modules/hello.

menu "Virtio (QEMU)"

config VIRTIO_BLK
	tristate "virtio-blk"
	default y

config VIRTIO_NET
	tristate "virtio-net"
	depends on NET
	default y

config VIRTIO_GPU
	bool "virtio-gpu"
	depends on DRM
	default y

config VIRTIO_KEYBOARD
	bool "virtio-input keyboard"
	default y

config VIRTIO_RNG
	tristate "virtio-rng"
	default y

config VIRTIO_SND
	tristate "virtio-snd"
	default y

endmenu

menu "Network"
	depends on NET

# The NIC drivers are compiled on every arch/board today (inert without the
# hardware), so they have no arch/board dependency: a PCI e1000e is also a
# QEMU aarch64 option, and macb/brcmf just never find their RP1/SDIO device.
config E1000E
	tristate "Intel e1000e"
	depends on PCI
	default y

config R8169
	bool "Realtek r8169"
	depends on PCI
	default y

config IWLWIFI
	bool "Intel iwlwifi"
	depends on PCI
	select WIFI_STACK
	default y

config WIFI_SIM
	bool "Simulated Wi-Fi device (testing)"
	depends on VIRTIO_NET=y
	select WIFI_STACK
	default y

config MACB
	bool "Cadence macb (Pi 5 RP1 Ethernet)"
	default y

config BRCMF
	bool "Broadcom brcmfmac (SDIO Wi-Fi)"
	select WIFI_STACK
	default y

endmenu

menu "Graphics, display and audio"

config I915
	bool "Intel i915"
	depends on PCI && DRM
	default y

config V3D
	bool "Broadcom V3D / KMS"
	depends on DRM && BOARD_RPI5
	default y

config HDMI_AUDIO
	bool "Pi 5 HDMI audio"
	depends on BOARD_RPI5
	default y

config HDA
	tristate "Intel HD Audio (+capture)"
	depends on PCI
	default y

endmenu

menu "Storage"

config NVME
	tristate "NVMe"
	depends on PCI
	default y

config SDHCI
	bool "SDHCI SD/eMMC (Pi 5, raspi4b)"
	depends on BOARD_RPI5 || BOARD_RASPI4B
	default y

endmenu

menu "Input"

config PSMOUSE
	bool "PS/2 mouse (i8042)"
	depends on ARCH_X86_64
	default y

config I2C_HID
	bool "I2C HID (+ DesignWare I2C, ACPI I2C, precision touchpad)"
	depends on ARCH_X86_64
	default y

endmenu

menu "Platform and power"

config ACPI_POWER
	bool "ACPI EC / battery"
	depends on ARCH_X86_64
	default y

config THERMAL
	bool "Thermal"
	depends on ARCH_X86_64
	default y

config PCI_PM
	bool "PCI power management"
	depends on PCI
	default y

config LAPINV
	bool "Laptop inventory/quirks"
	depends on ARCH_X86_64
	default y

endmenu

menu "Raspberry Pi 5 platform"
	depends on BOARD_RPI5

config BRCMSTB_PCIE
	bool "Broadcom STB PCIe"
	default y

config RP1
	bool "RP1 south bridge (USB, GPIO, clk, fan)"
	default y

config BCM2712_DMA40
	bool "BCM2712 DMA40"
	default y

config BCM2712_GPIO
	bool "BCM2712 GPIO / pinctrl"
	default y

config RPI_MAILBOX
	bool "VideoCore mailbox"
	default y

config RPI_MISC
	bool "Pi misc (OTP, ids)"
	default y

config RPI_PM
	bool "Pi power management"
	default y

config PI5_BOARD
	bool "Pi 5 board setup"
	default y

endmenu

source "drivers/usb/Kconfig"

endmenu
```

## drivers/usb/Kconfig
```kconfig
menu "USB"
	depends on USB

config USB_XHCI
	bool "xHCI host controller (+hub)"
	default y

config USB_HID
	tristate "USB HID boot keyboard and mouse"
	default y
	help
	  =m builds modules/usb-hid, loaded by the `usb 03 01 01|02` alias when the enumerator meets a
	  boot keyboard or mouse. Keep =y on any image whose only keyboard is USB.

config USB_STORAGE
	tristate "USB mass storage"
	default y
	help
	  =m builds modules/usb-storage, loaded by the `usb * * 08 06 50` alias (and listed in modules/BOOT
	  for a USB root). Keep =y on any image that boots from a USB stick.

config UVC
	bool "USB video class (webcam)"
	default y

config BT
	tristate "Bluetooth (btusb + bthid)"
	default y
	help
	  =m builds modules/bt (the USB HCI transport, Intel set-up), loaded by the `usb * * e0 01 01` alias.
	  The HCI node, the Pi UART transport and btd/bthid stay built in. Shipped configs keep =y.

config DWC3
	bool "DesignWare USB3 (Pi)"
	depends on ARCH_ARM64
	default y

endmenu
```
